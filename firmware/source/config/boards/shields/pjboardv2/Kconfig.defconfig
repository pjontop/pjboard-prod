## firmware/source/config/boards/shields/pjboardv2/Kconfig.defconfig
```kconfig
# SPDX-License-Identifier: MIT

if SHIELD_PJBOARDV2_LEFT

config ZMK_KEYBOARD_NAME
    default "PJBoard v2"

config ZMK_SPLIT_ROLE_CENTRAL
    default y

endif

if SHIELD_PJBOARDV2_LEFT || SHIELD_PJBOARDV2_RIGHT

config ZMK_SPLIT
    default y

endif
```

## firmware/source/config/boards/shields/pjboardv2/Kconfig.shield
```kconfig
# SPDX-License-Identifier: MIT

config SHIELD_PJBOARDV2_LEFT
    def_bool $(shields_list_contains,pjboardv2_left)

config SHIELD_PJBOARDV2_RIGHT
    def_bool $(shields_list_contains,pjboardv2_right)
```

## firmware/source/config/west.yml
```yaml
manifest:
  remotes:
    - name: zmkfirmware
      url-base: https://github.com/zmkfirmware
    - name: zzeneg
      url-base: https://github.com/zzeneg
  projects:
    - name: zmk
      remote: zmkfirmware
      revision: v0.3
      import: app/west.yml
    - name: zmk-nice-view-hid
      remote: zzeneg
      revision: 9bee6b9dec38a22b428cdc55274ea36e6e8b7ddf
    - name: zmk-raw-hid
      remote: zzeneg
      revision: e25e325adc90fccb60cc08393b8c2b0ba6d647c7
  self:
    path: config
```
