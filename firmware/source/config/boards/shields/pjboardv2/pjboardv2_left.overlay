/* SPDX-License-Identifier: MIT */

#include "pjboardv2.dtsi"

&kscan0 {
    /* PCB COL0..COL5: P0.17, P1.00, P0.24, P0.22, P0.08, P1.06 */
    col-gpios
        = <&gpio0 17 GPIO_ACTIVE_HIGH>
        , <&gpio1 0  GPIO_ACTIVE_HIGH>
        , <&gpio0 24 GPIO_ACTIVE_HIGH>
        , <&gpio0 22 GPIO_ACTIVE_HIGH>
        , <&gpio0 8  GPIO_ACTIVE_HIGH>
        , <&gpio1 6  GPIO_ACTIVE_HIGH>
        ;
};
